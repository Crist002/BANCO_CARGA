#include<Wire.h>
#include <SPI.h>
#include<RTClib.h>
#include <SD.h>
#include <LiquidCrystal_I2C.h>
LiquidCrystal_I2C lcd(0x27,16,2);
//variable LCD
const byte columna = 0;
byte fila;
const byte columna2 = 1;
byte fila2;
String contenido;
String contenido2;
//CONFIGURACION DEL RTC
RTC_DS1307 rtc;
DateTime HoraFecha;
int segundo,minuto,hora,dia,mes;
int anio;
//CONFIGURACION DEL SD
File myFile;
int conteo = 0;
//////////////////////////////////////////////////////////////////////////////////////////////////////////////////////////////////////////////////////////////////////////////
//////////////////////////////////////////////////////////////////////////////////////////////////////////////////////////////////////////////////////////////////////////////
//////////////////////////////////////////////////////////////////////////////////////////////////////////////////////////////////////////////////////////////////////////////


void setup() {
  lcd.init();                  
  lcd.backlight();
  rtc.begin();    //INICIA EL RTC
  contenido = "Iniciando SD ...";
  Visual();
  delay(1000);
  while(!SD.begin(10)) {      //INICIA EL SD A TRAVEZ DEL PIN 10 (CS), NO CAMBIAR SI SE USA LA SHIELD DATALOGGER
    contenido = "No se pudo iniciar SD";
    Visual();
    delay(1000);
  }
  contenido = "SD INICIADA";
  Visual();
  delay(1000);
  if(!SD.exists("Tiempo.csv")){
      myFile = SD.open("Tiempo.csv", FILE_WRITE);
      if (myFile) {
        myFile.println("FECHA,HORA");
        myFile.close();
      } else {
        contenido="Error creando el archivo datalog.csv";
        Visual();
        delay(1000);
      }
  }
}
//////////////////////////////////////////////////////////////////////////////////////////////////////////////////////////////////////////////////////////////////////////////
//////////////////////////////////////////////////////////////////////////////////////////////////////////////////////////////////////////////////////////////////////////////
//////////////////////////////////////////////////////////////////////////////////////////////////////////////////////////////////////////////////////////////////////////////

void loop() {
  Lectura_Tiempo();
  Escritura_SD();
  delay(2000);
}

//////////////////////////////////////////////////////////////////////////////////////////////////////////////////////////////////////////////////////////////////////////////
//////////////////////////////////////////////////////////////////////////////////////////////////////////////////////////////////////////////////////////////////////////////
//////////////////////////////////////////////////////////////////////////////////////////////////////////////////////////////////////////////////////////////////////////////

void Lectura_Tiempo(){
  HoraFecha = rtc.now();
  segundo    = HoraFecha.second();
  minuto     = HoraFecha.minute();
  hora       = HoraFecha.hour();
  dia        = HoraFecha.day();
  mes        = HoraFecha.month();
  anio       = HoraFecha.year();
}

void Escritura_SD(){
  myFile = SD.open("Tiempo.csv", FILE_WRITE);
  myFile.print(String(dia) + "/" + mes + "/" + anio);
  myFile.print(",");
  myFile.println(String(hora) + ":" + minuto + ":" + segundo);
  myFile.close();
  conteo++;
  contenido = "GUARDADO " + String(conteo);
  Visual();
}

void Visual(){    //Configuro lo que se visualizara en el LCD
  lcd.clear();
  lcd.setCursor(fila,columna);
  lcd.print(contenido);
  lcd.setCursor(fila2,columna2);
  lcd.print(contenido2);
}
